## CMakeLists.txt
```
# Copyright (c) 2020 Abhijit Bose <https://boseji.com>
# SPDX-License-Identifier: Apache-2.0

cmake_minimum_required(VERSION 3.13.1)
# Re-direct the directory where the 'boards' directory is found from
# $ZEPHYR_BASE to this directory.
set(BOARD_ROOT ${CMAKE_CURRENT_LIST_DIR})

# This sample is only compatible with stm32f3_disco because it has
# re-directed the 'boards' directory to a directory that only contains
# this board.
set(BOARD stm32f3_disco)

# Get Zephyr using the configured environment variable
find_package(Zephyr REQUIRED HINTS $ENV{ZEPHYR_BASE})

# The Project Name
project(fancier_blinky_stm32f3_disco)

# Collect all the files in the Source Directory for build target
FILE(GLOB app_sources src/*.c)
target_sources(app PRIVATE ${app_sources})

# Older Method of Grouping
#target_sources(app PRIVATE src/main.c)
```

## prj.conf
```kconfig
CONFIG_GPIO=y
CONFIG_DEBUG=y
```

## src/main.c
```c
/*
 * Copyright (c) 2020 Abhijit Bose <https://boseji.com>
 *
 * SPDX-License-Identifier: Apache-2.0
 */

#include <device.h>
#include <devicetree.h>
#include <drivers/gpio.h>
#include <zephyr.h>

void main(void) {
  struct device *gpioe;
  int i;
  /* LED Pins */
  uint8_t pins[] = {9 /*LD3*/,   10 /*LD5*/, 11 /*LD7*/, 12 /*LD9*/,
                    13 /*LD10*/, 14 /*LD8*/, 15 /*LD6*/, 8 /*LD4*/};

  /* Get instance of GPIOE */
  gpioe = device_get_binding("GPIOE");
  if (gpioe == NULL) {
    return;
  }

  /* Enabled All pins for Output*/
  for (i = 0; i < sizeof(pins); i++) {
    gpio_pin_configure(gpioe, pins[i], GPIO_OUTPUT_ACTIVE);
  }

  /* Perform Initial configuration */
  i = 0;
  gpio_pin_set(gpioe, pins[i], 0); /* For the fist time OFF */

  /* Start the Infinite Loop */
  while (1) {

    /* First GPIO Toggle */
    gpio_pin_toggle(gpioe, pins[i]);
    /* Increment the Counter avoiding overflow */
    if (i < sizeof(pins) - 1) {
      i++;
    } else {
      i = 0;
    }
    /* Second GPIO Toggle - give the ripple effect */
    gpio_pin_toggle(gpioe, pins[i]);
    /* Wait for a short time */
    k_msleep(100);

  } /* End of While */
}
```
